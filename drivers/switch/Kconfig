## drivers/switch/Kconfig
```kconfig
menuconfig SWITCH
	tristate "Switch class support"
	help
	  Say Y here to enable switch class support. This allows
	  monitoring switches by userspace via sysfs and uevent.

if SWITCH

config SWITCH_GPIO
	tristate "GPIO Switch support"
	depends on SWITCH && GENERIC_GPIO
	help
	  Say Y here to enable GPIO based switch support.

config SWITCH_TOGGLE
	tristate "Toggle Switch support"
	depends on SWITCH
	help
	  Say Y here to enable toggle switch support.


config SWITCH_FSA9480
	tristate "FSA9480 USB Switch"
	depends on SWITCH && I2C
	help
	  Say Y here to enable FSA9480 USB switch support.

	  The FSA9480 is a USB port accessory detector and switch.
	  The FSA9480 is fully controlled using I2C and enables USB data,
	  stereo and mono audio, video, microphone and UART data to use
	  a common connector port.

config SWITCH_QSS_BOOTPARAM
	tristate "QSS Boot Parameter support"
	depends on SWITCH && MACH_QSS
	help
	  Say Y here to enable QSS Boot Parameter support.

endif # SWITCH
```
